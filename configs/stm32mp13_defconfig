## configs/stm32mp13_defconfig
```kconfig
CONFIG_ARM=y
CONFIG_ARCH_STM32MP=y
CONFIG_TFABOOT=y
CONFIG_SYS_MALLOC_F_LEN=0x4000
CONFIG_SYS_MEMTEST_START=0xc0000000
CONFIG_SYS_MEMTEST_END=0xc1000000
CONFIG_ENV_OFFSET=0x900000
CONFIG_ENV_SECT_SIZE=0x40000
CONFIG_DEFAULT_DEVICE_TREE="stm32mp135f-dk"
CONFIG_STM32MP13x=y
CONFIG_DDR_CACHEABLE_SIZE=0x10000000
CONFIG_TARGET_ST_STM32MP13x=y
CONFIG_ENV_OFFSET_REDUND=0x940000
CONFIG_DISTRO_DEFAULTS=y
CONFIG_FIT=y
CONFIG_BOOTDELAY=0
CONFIG_BOOTCOMMAND="run bootcmd_stm32mp"
CONFIG_SYS_PROMPT="STM32MP> "

# Essential commands only
CONFIG_CMD_MEMINFO=y
CONFIG_CMD_UNZIP=y
CONFIG_CMD_CACHE=y
CONFIG_CMD_TIME=y

# Minimal environment settings
CONFIG_ENV_IS_NOWHERE=y
CONFIG_ENV_IS_IN_MMC=y
CONFIG_SYS_REDUNDAND_ENVIRONMENT=y
CONFIG_SYS_RELOC_GD_ENV_ADDR=y
CONFIG_SYS_MMC_ENV_DEV=0

# Minimal peripheral support
CONFIG_DM=y
CONFIG_SUPPORT_EMMC_BOOT=y
CONFIG_STM32_SDMMC2=y

# Serial console
CONFIG_CONSOLE_NORMAL=y
CONFIG_SERIAL_RX_BUFFER=y

# Basic GPIO for board init
CONFIG_GPIO_HOG=y

# LED (optional for diagnostics)
CONFIG_LED=y
CONFIG_LED_GPIO=y

# RTC if required
CONFIG_DM_RTC=y
CONFIG_RTC_STM32=y

# Watchdog (optional, remove if unused)
CONFIG_WDT=y
CONFIG_WDT_STM32MP=y

# Reduce memory regions for faster relocation
CONFIG_LMB_MEMORY_REGIONS=1
CONFIG_LMB_RESERVED_REGIONS=4

# Video (only if splash or framebuffer needed)
# CONFIG_DM_VIDEO=y
# CONFIG_VIDEO_STM32=y

# Disable unused features
# CONFIG_TEE is not set
# CONFIG_OPTEE is not set
# CONFIG_CMD_MEMTEST is not set
# CONFIG_CMD_ADC is not set
# CONFIG_CMD_DFU is not set
# CONFIG_CMD_FUSE is not set
# CONFIG_CMD_GPIO is not set
# CONFIG_CMD_I2C is not set
# CONFIG_CMD_SPI is not set
# CONFIG_CMD_USB is not set
# CONFIG_CMD_USB_MASS_STORAGE is not set
# CONFIG_CMD_BMP is not set
# CONFIG_CMD_RNG is not set
# CONFIG_CMD_TIMER is not set
# CONFIG_CMD_REGULATOR is not set
# CONFIG_CMD_UBI is not set
# CONFIG_USB is not set
# CONFIG_USB_GADGET is not set
# CONFIG_DM_USB_GADGET is not set
# CONFIG_DM_ETH is not set
# CONFIG_DWC_ETH_QOS is not set
# CONFIG_PHY is not set
# CONFIG_MTD is not set
# CONFIG_MTD_RAW_NAND is not set
# CONFIG_MTD_SPI_NAND is not set
# CONFIG_DM_SPI_FLASH is not set
# CONFIG_FASTBOOT_USB_DEV is not_
```
